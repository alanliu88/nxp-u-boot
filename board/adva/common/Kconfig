## board/adva/common/Kconfig
```kconfig
config ADVA_COMMON_LIB
	bool  "adva common library"
	default y

config ADVA_DS31407
	bool "adva ds31407 debug command"
	default n

config ADVA_DS31407_CS
	int "ds31407 spi chicp select"
	depends on ADVA_DS31407

config ADVA_CMD_BOOTUBI
	bool "bootubi command boot"
	help 
		a wrapper command to ubifs and bootm, which is used to boot from adva nand
	default y
```

## board/adva/ge104/Kconfig
```kconfig
if TARGET_GE104

config SYS_BOARD
	default "ge104"

config SYS_VENDOR
	default "adva"

config SYS_SOC
	default "fsl-layerscape"

config SYS_CONFIG_NAME
	default "ge104"

config SYS_LS_PPA_FW_ADDR
        hex "PPA Firmware Addr"
        default 0x40100000

config SYS_I2C_CPLD_BUS_NUM
	hex "i2c cpld bus"
	default 1

config SYS_I2C_CPLD_ADDR
	hex "i2c cpld address"
	default 0x42

config SYS_I2C_CPLD_PROG_ADDR
	hex "i2c cpld programing address"
	default 0x40

config DEBUG_CMD
	bool "enable debug command"
	default y

config DEBUG_PASSWORD
	string "debug command password"
	default "2ab5ce2f5dd2468d3bee2fd23096960ae03cadfd5a518221"

config USE_FSP150_VERSION
	bool "use adva defined version format"
	default y

if CHAIN_OF_TRUST
config SYS_LS_PPA_ESBC_ADDR
	hex "PPA Firmware HDR Addr"
	default 0x40680000
endif

if FSL_PFE

config BOARD_SPECIFIC_OPTIONS # dummy
	def_bool y
	select PHYLIB
	imply PHY_REALTEK

config SYS_LS_PFE_FW_ADDR
	hex "Flash address of PFE firmware"
	default 0x400f0000

config DDR_PFE_PHYS_BASEADDR
	hex "PFE DDR physical base address"
	default 0x03800000

config DDR_PFE_BASEADDR
	hex "PFE DDR base address"
	default 0x83800000

config PFE_EMAC1_PHY_ADDR
	hex "PFE DDR base address"
	default 0x2

config PFE_EMAC2_PHY_ADDR
	hex "PFE DDR base address"
	default 0x4

endif

source "board/freescale/common/Kconfig"
source "board/adva/common/Kconfig"

endif
```

## board/adva/ge110pro/Kconfig
```kconfig
if TARGET_GE110PRO

config SYS_BOARD
	default "ge110pro"

config SYS_VENDOR
	default "adva"

config SYS_SOC
	default "ls102xa"

config SYS_CONFIG_NAME
	default "ge110pro"

config SKDIFILE
	string
	default "fsp150.skdi"

config FDTFILE
	string
	default "ge110pro.dtb"

source "board/freescale/common/Kconfig"
source "board/adva/common/Kconfig"


endif
```
